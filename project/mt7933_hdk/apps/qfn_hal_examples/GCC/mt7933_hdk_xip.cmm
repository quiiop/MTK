SYStem.RESet
SYStem.CPU CORTEXM33F
SYStem.Option ENRESET ON
SYStem.Option TRST ON
SYStem.Option ResBreak OFF
SYStem.Option WaitReset OFF
SYStem.JtagClock 1MHz
;sys.mode prepare
;if swd mode, need set debug port type to swd
SYStem.CONFIG.DEBUGPORTTYPE SWD
SYStem.Up

Setup.IMASKHLL ON
Setup.IMASKASM ON

Break.Select Program OnChip
Break.Select Hll OnChip
Break.Select Spot OnChip
Break.Select Read OnChip
Break.Select Write OnChip

; TODO: Disable watch dog
;D.S SD:0x21020030 %LE %WORD 0x2200

; TODO: EMI init
;D.S SD:0x0        %LE %LONG 0x5a5a5a5a
;D.S SD:0x4        %LE %LONG 0x5a5a5a5a
;D.S SD:0xA00500A0 %LE %LONG 0x0d030000
;D.S SD:0xA0050030 %LE %LONG 0x0
;D.S SD:0xA0050048 %LE %LONG 0x1e0000 

; disable boot slave, 
; boot_vec_sel: 0x2106_0008[0] (bit 0) 
; 0 - boot from ROM
; 1 - boot from { BOOT_VECTOR1, BOOT_VECTOR0 }
;D.S SD:0x21060008 %LE %LONG 0x0

; TODO: disable cache 
;D.S SD:0x20000000 %LE %LONG 0x0

Local &start &end
&start=clock.seconds()

&end=clock.seconds()
Print "Elapsed time is " &end-&start    " seconds"

; Clear the exceptions: AIRCR.VECTCLRACTIVE
d.s asd:0xE000ED0C %le %long 0x05FA0002

; ===================================================================
; Download the binary image to PSRAM directly
; ===================================================================
D.LOAD.ELF .\qfn_evb.elf /quad /nocode

R.S R13 0x80040000      ; set stack pointer to the end of CM33 TCM
R.S PC Reset_Handler    ; real target bypass BROM effect

; source path remapping
; Y.SPATH.T "\proj\mtkXXXXX" "\\mtksfs01\mtkXXXXX"

; TODO: add source path
; y.spath M:\MT7933\20200301\project\mt7933_hdk\apps\iot_sdk_demo\GCC
; y.spath M:\MT7933\20200301\project\mt7933_hdk\apps\iot_sdk_demo\src
; y.spath M:\MT7933\20200301\project\mt7933_hdk\apps\iot_sdk_demo\ut
; y.spath M:\MT7933\20200301\kernel\rtos\FreeRTOS\SourceV10
; y.spath M:\MT7933\20200301\kernel\rtos\FreeRTOS\SourceV10\portable\GCC\ARM_CM33\non_secure
; y.spath M:\MT7933\20200301\kernel\rtos\FreeRTOS\SourceV10\portable\GCC\mt7933
; y.spath M:\MT7933\20200301\kernel\service\src
; y.spath M:\MT7933\20200301\driver\chip\mt7933\src
; y.spath M:\MT7933\20200301\driver\board\mt7933_hdk\util\src
; y.spath M:\MT7933\20200301\kernel\rtos\FreeRTOS\SourceV10\portable\MemMang
; y.spath M:\MT7933\20200301\middleware\MTK\nvdm\src
; y.spath M:\MT7933\20200301\middleware\MTK\nvdm_core\src_core
; y.spath M:\MT7933\20200301\kernel\rtos\FreeRTOS_test\src
; y.spath M:\MT7933\20200301\middleware\MTK\minicli\src
; y.spath M:\MT7933\20200301\middleware\MTK\minicli_protected\src

;WinCLEAR
D.L

;v.watch %Hex (SCB_Type *)0xE000ED00
;v.watch %Hex (NVIC_Type *)0xE000E100
;v.watch %Hex (MPU_Type *)0xE000ED90

b.s main
;Register.View

